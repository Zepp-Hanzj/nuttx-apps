## examples/lvgldemo/Kconfig
```kconfig
#
# For a description of the syntax of this configuration file,
# see the file kconfig-language.txt in the NuttX tools repository.
#

menuconfig EXAMPLES_LVGLDEMO
	tristate "LVGL Demo"
	default n
	depends on GRAPHICS_LVGL
	---help---
		Enable build the Light and Versatile Graphics Library Demo programs

if EXAMPLES_LVGLDEMO

config EXAMPLES_LVGLDEMO_PRIORITY
	int "lvgldemo task priority"
	default 100

config EXAMPLES_LVGLDEMO_STACKSIZE
	int "lvgldemo stack size"
	default 16384

config EXAMPLES_LVGLDEMO_INPUT_DEVPATH
	string "Touchscreen device path"
	default "/dev/input0"
	depends on INPUT_TOUCHSCREEN
	---help---
		The path to the touchscreen device. Default: "/dev/input0"

config EXAMPLES_LVGLDEMO_WIFI
	bool "Wi-Fi connection screen"
	default n
	depends on NET && WIRELESS_WAPI && NETUTILS_DHCPC
	---help---
		Add a touch-friendly Wi-Fi scan and connection screen.  Start it
		with "lvgldemo wifi".  Scanning, association and DHCP run in a
		worker thread so the LVGL render loop remains responsive.

config EXAMPLES_LVGLDEMO_WIFI_IFNAME
	string "Wi-Fi interface name"
	default "wlan0"
	depends on EXAMPLES_LVGLDEMO_WIFI

config EXAMPLES_LVGLDEMO_WIFI_WORKER_STACKSIZE
	int "Wi-Fi worker stack size"
	default 6144
	depends on EXAMPLES_LVGLDEMO_WIFI

endif # EXAMPLES_LVGLDEMO
```
